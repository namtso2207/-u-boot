## arch/arm/mach-rockchip/rk3588/Kconfig
```kconfig
if ROCKCHIP_RK3588

config TARGET_EVB_RK3588
	bool "EVB_RK3588"
	select BOARD_LATE_INIT
	help
	  RK3588 EVB is a evaluation board for Rockchp RK3588.

config TARGET_NAMTSO_A10_3588
	bool "Namtso A10-3588"
	select BOARD_LATE_INIT
	help
	  Namtso A10-3588

config SYS_SOC
	default "rockchip"

config SYS_MALLOC_F_LEN
	default 0x400

source board/rockchip/evb_rk3588/Kconfig
source board/namtso/namtso-a10-3588/Kconfig

endif
```

## board/namtso/namtso-a10-3588/Kconfig
```kconfig
if TARGET_NAMTSO_A10_3588

config SYS_BOARD
	default "namtso-a10-3588"

config SYS_VENDOR
	default "namtso"

config SYS_CONFIG_NAME
	default "namtso-a10-3588"

config BOARD_SPECIFIC_OPTIONS # dummy
	def_bool y

endif
```
